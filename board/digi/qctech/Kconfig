## board/digi/qctech/Kconfig
```kconfig
if TARGET_CCIMX6ULSBC

config MCA
	bool
	default y

config SYS_BOARD
	default "qctech"

config SYS_VENDOR
	default "digi"

config SYS_SOC
	default "mx6"

config SYS_CONFIG_NAME
	default "qctech"

endif
```
